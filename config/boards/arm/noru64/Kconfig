## config/boards/arm/noru64/Kconfig
```kconfig
config BOARD_ENABLE_DCDC
	bool "Enable DCDC mode"
	select SOC_DCDC_NRF52X
	default y
	depends on (BOARD_NORU64_V1_LEFT || BOARD_NORU64_V1_RIGHT)
	
```

## config/boards/arm/noru64/Kconfig.board
```kconfig
# SP56 board configuration

# Copyright (c) 2020 Eric Lau
# SPDX-License-Identifier: MIT

config BOARD_NORU64_V1_LEFT
	bool "noru64_v1_left"
	depends on SOC_NRF52840_QIAA

config BOARD_NORU64_V1_RIGHT
	bool "noru64_v1_right"
	depends on SOC_NRF52840_QIAA
```

## config/boards/arm/noru64/Kconfig.defconfig
```kconfig
# Copyright (c) 2020 Eric Lau
# SPDX-License-Identifier: MIT

if BOARD_NORU64_V1_LEFT

	config ZMK_KEYBOARD_NAME
	default "Noru64 v1 L"

endif # BOARD_NORU64_V1_LEFT


if BOARD_NORU64_V1_RIGHT

	config ZMK_KEYBOARD_NAME
	default "Noru64 v1 R"

endif # BOARD_NORU64_V1_RIGHT


if BOARD_NORU64_V1_LEFT || BOARD_NORU64_V1_RIGHT

config BOARD
	default "Noru64"

config ZMK_SPLIT
	default y

config BT_CTLR
	default BT

config ZMK_BLE
	default y

config ZMK_USB
	default y

config ZMK_BATTERY_VOLTAGE_DIVIDER
	default y

if USB

config USB_NRFX
	default y

config USB_DEVICE_STACK
	default y

endif # USB

endif # BOARD_NORU64_V1_LEFT || BOARD_NORU64_V1_RIGHT
```

## config/boards/arm/noru64/noru64_v1_left_defconfig
```kconfig
# SPDX-License-Identifier: MIT

CONFIG_SOC_SERIES_NRF52X=y
CONFIG_SOC_NRF52840_QIAA=y
CONFIG_BOARD_NORU64_V1_LEFT=y

#Enable split keyboard
CONFIG_ZMK_SPLIT=y

#Enable master side
CONFIG_ZMK_SPLIT_ROLE_CENTRAL=y

#Enable sleep

CONFIG_ZMK_SLEEP=n

#Enable backlight
CONFIG_ZMK_BACKLIGHT=y
CONFIG_ZMK_BACKLIGHT_BRT_STEP=5
CONFIG_ZMK_BACKLIGHT_BRT_START=5
CONFIG_ZMK_BACKLIGHT_ON_START=y
CONFIG_ZMK_BACKLIGHT_AUTO_OFF_IDLE=y
CONFIG_ZMK_BACKLIGHT_AUTO_OFF_USB=n

# Enable MPU
CONFIG_ARM_MPU=y

# enable GPIO
CONFIG_GPIO=y

# Enable writing to flash
CONFIG_USE_DT_CODE_PARTITION=y
CONFIG_MPU_ALLOW_FLASH_WRITE=y
CONFIG_NVS=y
CONFIG_SETTINGS_NVS=y
CONFIG_FLASH=y
CONFIG_FLASH_PAGE_LAYOUT=y
CONFIG_FLASH_MAP=y

# RGB
CONFIG_ZMK_RGB_UNDERGLOW=y
CONFIG_WS2812_STRIP=y
CONFIG_ZMK_RGB_UNDERGLOW_EXT_POWER=n
CONFIG_ZMK_RGB_UNDERGLOW_ON_START=n

# Enable external crystal
CONFIG_CLOCK_CONTROL_NRF_K32SRC_XTAL=y
CONFIG_CLOCK_CONTROL_NRF_K32SRC_30PPM=y

# # Turn on logging, and set ZMK logging to debug output
# CONFIG_ZMK_USB_LOGGING=y

CONFIG_BUILD_OUTPUT_UF2=y
```

## config/boards/arm/noru64/noru64_v1_right_defconfig
```kconfig
# Copyright (c) 2021 The ZMK Contributors
#
# SPDX-License-Identifier: MIT

CONFIG_SOC_SERIES_NRF52X=y
CONFIG_SOC_NRF52840_QIAA=y
CONFIG_BOARD_NORU64_V1_RIGHT=y

#Enable split keyboard
CONFIG_ZMK_SPLIT=y

#Enable master side
CONFIG_ZMK_SPLIT_ROLE_CENTRAL=y

#Enable sleep
CONFIG_ZMK_SLEEP=n

#Enable backlight
# CONFIG_ZMK_BACKLIGHT=y
# CONFIG_ZMK_BACKLIGHT_BRT_STEP=5
# CONFIG_ZMK_BACKLIGHT_BRT_START=5
# CONFIG_ZMK_BACKLIGHT_ON_START=y
# CONFIG_ZMK_BACKLIGHT_AUTO_OFF_IDLE=y
# CONFIG_ZMK_BACKLIGHT_AUTO_OFF_USB=n

# Enable MPU
CONFIG_ARM_MPU=y

# enable pinctrl
CONFIG_PINCTRL=y

# enable GPIO
CONFIG_GPIO=y


# Enable writing to flash
CONFIG_USE_DT_CODE_PARTITION=y
CONFIG_MPU_ALLOW_FLASH_WRITE=y
CONFIG_NVS=y
CONFIG_SETTINGS_NVS=y
CONFIG_FLASH=y
CONFIG_FLASH_PAGE_LAYOUT=y
CONFIG_FLASH_MAP=y

# Enable external crystal
CONFIG_CLOCK_CONTROL_NRF_K32SRC_XTAL=y
CONFIG_CLOCK_CONTROL_NRF_K32SRC_30PPM=y

# Turn on logging, and set ZMK logging to debug output
#CONFIG_LOG=y
#CONFIG_ZMK_USB_LOGGING=y
#CONFIG_ZMK_LOG_LEVEL_DBG=y
#CONFIG_LOG_BUFFER_SIZE=65536
#CONFIG_LOG_STRDUP_BUF_COUNT=160
#CONFIG_I2C_LOG_LEVEL_DBG=y
#CONFIG_SPI_LOG_LEVEL_DBG=y
#CONFIG_SENSOR_LOG_LEVEL_DBG=y

# RGB
CONFIG_ZMK_RGB_UNDERGLOW=y
CONFIG_WS2812_STRIP=y
CONFIG_ZMK_RGB_UNDERGLOW_EXT_POWER=n
CONFIG_ZMK_RGB_UNDERGLOW_ON_START=n

CONFIG_BUILD_OUTPUT_UF2=y
```

## config/west.yml
```yaml
manifest:
  remotes:
    - name: zmkfirmware
      url-base: https://github.com/zmkfirmware
    - name: kien242
      url-base: https://github.com/kien242
    - name: zmkfirmware-infused-kim
      url-base: https://github.com/infused-kim
    - name: zmkfirmware-split-battery-report
      url-base: https://github.com/Katona/
    - name: luna
      url-base: https://github.com/pitchayath/
  projects:
    - name: zmk
    
      remote: zmkfirmware
      revision: main

      import: app/west.yml
  self:
    path: config
```
